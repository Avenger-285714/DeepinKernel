## drivers/gpu/drm/mwv206/Kconfig
```kconfig
config DRM_MWV206
       tristate "MWV206 chip"
       depends on DRM && SND_PCM
       depends on X86 || COMPILE_TEST
       select DRM_KMS_HELPER
       select DRM_VRAM_HELPER
       select DRM_TTM
       select DRM_SCHED
       select FB_IOMEM_HELPERS if DRM_FBDEV_EMULATION
       select DRM_GEM_SHMEM_HELPER
       select DRM_DEVFREQ
       select DRM_TTM_HELPER
       help
         Choose this option if you have a Jingjia graphics card. 
          If M is selected, the module will be called mwv206 (JM7200).
```
